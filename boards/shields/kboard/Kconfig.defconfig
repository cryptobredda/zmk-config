## boards/shields/kboard/Kconfig.defconfig
```kconfig
# Copyright (c) 2020 Pete Johanson, Kurtis Lew
# SPDX-License-Identifier: MIT

if SHIELD_KBOARD_LEFT

config ZMK_KEYBOARD_NAME
    default "Kboard"

config ZMK_SPLIT_ROLE_CENTRAL
    default y

endif

if SHIELD_KBOARD_LEFT || SHIELD_KBOARD_RIGHT

config ZMK_SPLIT
    default y

endif
```

## boards/shields/kboard/Kconfig.shield
```kconfig
config SHIELD_KBOARD_LEFT
    def_bool $(shields_list_contains, kboard_left)

config SHIELD_KBOARD_RIGHT
    def_bool $(shields_list_contains, kboard_right)
```
